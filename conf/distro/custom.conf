## conf/distro/custom.conf
```bitbake
require conf/distro/poky.conf

DISTRO = "custom"

# default: poky/meta/conf/distro/include/default-distrovars.inc
DISTRO_FEATURES_DEFAULT = " \
    acl \
    ext2 \
    largefile \
    pcmia \
    xattr \
   "

# default: poky/meta-poky/conf/distro/poky.conf
POKY_DEFAULT_DISTRO_FEATURES = " \
    largefile \
    vulkan \
   "

# default: poky/meta-poky/conf/distro/poky.conf
# DISTRO_FEATURES ?= "${DISTRO_FEATURES_DEFAULT} ${DISTRO_FEATURES_LIBC} ${POKY_DEFAULT_DISTRO_FEATURES}"

# default: poky/meta/conf/bitbake.conf
DISTRO_FEATURES_BACKFILL = " \
    sysvinit \
    bluez5 \
    gobject-introspection-data \
    ldconfig \
   "

DISTRO_FEATURES_append = " \
    directfb \
   "

COPY_LIC_MANIFEST = " 1 "
COPY_LIC_DIRS = " 1 "

PACKAGECONFIG_append_pn-strongswan = " swanctl "
```
